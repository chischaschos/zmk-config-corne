## boards/shields/nice_view_key_display/Kconfig.shield
```kconfig
# Copyright (c) 2024 ZMK Contributors
# SPDX-License-Identifier: MIT

config SHIELD_NICE_VIEW_KEY_DISPLAY
    def_bool $(shields_list_contains,nice_view_key_display)
```
